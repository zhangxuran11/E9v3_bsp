## resource/uboot_4.1.15_2.0.0-ga/board/freescale/tqe9v3/Kconfig
```kconfig
if TARGET_TQE9V3

config SYS_BOARD
	default "tqe9v3"

config SYS_VENDOR
	default "freescale"

config SYS_CONFIG_NAME
	default "tqe9v3"

endif
```

## resource/uboot_4.1.15_2.0.0-ga/configs/tqe9v3_defconfig
```kconfig
CONFIG_ARM=y
CONFIG_ARCH_MX6=y
CONFIG_TARGET_TQE9V3=y
CONFIG_SYS_EXTRA_OPTIONS="IMX_CONFIG=board/freescale/tqe9v3/mx6q_4x_mt41j128_tqe9v3.cfg,MX6Q,SYS_USE_SPINOR"
CONFIG_CMD_GPIO=y
```

## resource/uboot_4.14.98-2.0.0_ga/board/embedsky/tqe9v3/Kconfig
```kconfig
if TARGET_TQE9_V3

config SYS_BOARD
	default "tqe9v3"

config SYS_VENDOR
	default "embedsky"

config SYS_CONFIG_NAME
	default "mx6sabresd"

config SYS_TEXT_BASE
    default 0x17800000

endif
```

## resource/uboot_4.14.98-2.0.0_ga/board/freescale/tqe9v3/Kconfig
```kconfig
if TARGET_TQE9V3

config SYS_BOARD
	default "tqe9v3"

config SYS_VENDOR
	default "freescale"

config SYS_CONFIG_NAME
	default "mx6sabresd"

config SYS_TEXT_BASE
    default 0x17800000

endif
```
